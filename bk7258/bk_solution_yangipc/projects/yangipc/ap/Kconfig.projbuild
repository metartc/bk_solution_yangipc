## bk7258/bk_solution_yangipc/projects/yangipc/ap/Kconfig.projbuild
```kconfig
menu "INTEGRATION_YANGIPC"

    config INTEGRATION_YANGIPC
        bool "YangIPC integration"
        default n
    config YANGIPC_TXPOOL
        bool "yangipc_txpool"
        default n
    config YANGIPC_TXPOOL_SIZE
        int "yangipc_txpool_size"
        default 10
    config YANGIPC_TXPOOL_PAYLOAD_SIZE
        int "yangipc_txpool_payload_size"
        default 2208
    config YANGENCODER
        bool "Support yangencoder"
        default n
    config YANGSIGNAL
        bool "Support yangsignal"
        default n
endmenu
```
